// SPDX-License-Identifier: GPL-2.0-only
/*
 * LG V60 ThinQ 5G (timelm) sb_jp rev_c, from LG
 * kona-timelm_sb_jp/kona-timelm_sb_jp_rev-c-overlay.dts.
 * Not ported:
 * - &lge_usb_ds3 accessory detect by comparator (lge,acc_det_vcomp,
 *   lge,acc-detect = <&pm8150l_gpios 10 0x0>, lge,ds-en-gpio =
 *   <&tlmm 169 0>, lge,acc-supply = <&pm8150a_l3>): no lge_usb_ds3 node
 *   or driver here.
 */

#ifndef TIMELM_DTBO
/dts-v1/;
#include "kona-timelm.dtsi"
#endif
#include "kona-timelm_sb_jp.dtsi"
#include "kona-timelm-camera_revb.dtsi"
#include "kona-timelm_common-sound_rev-b.dtsi"
#include "kona-timelm_common-flicker.dtsi"

/ {
	model = "LG Electronics, Timelm_sb_jp, rev_c";
	qcom,board-id = <0x03080008 0>;
};

&pm8150a_l3 {
	regulator-min-microvolt = <1200000>;
	regulator-max-microvolt = <1200000>;
	qcom,init-voltage = <1200000>;
};
