// SPDX-License-Identifier: GPL-2.0-only
/*
 * dtbo entry for lao_ldu rev_d: LG kona-timelm_lao_ldu/kona-timelm_lao_ldu_rev-d-overlay.dts.
 * Same source as kona-timelm_lao_ldu_rev-d.dts without the base; LK applies it to
 * kona-timelm.dtb (boot image) when its qcom,board-id matches.
 */

/dts-v1/;
/plugin/;

#define TIMELM_DTBO
#include "kona-timelm-dtbo.dtsi"
#include "kona-timelm_lao_ldu_rev-d.dts"
