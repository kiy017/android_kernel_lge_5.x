// SPDX-License-Identifier: GPL-2.0-only
/*
 * LG V60 ThinQ 5G (timelm) sb_jp rev_a, from LG
 * kona-timelm_sb_jp/kona-timelm_sb_jp_rev-a-overlay.dts.
 * Not ported:
 * - &lge_usb_debugger lge,always-console-enable: no lge_usb_debugger
 *   node or driver here, and this port uses no UART console.
 */

#ifndef TIMELM_DTBO
/dts-v1/;
#include "kona-timelm.dtsi"
#endif
#include "kona-timelm_sb_jp.dtsi"
#include "kona-timelm-camera_reva.dtsi"

/ {
	model = "LG Electronics, Timelm_sb_jp, rev_a";
	qcom,board-id = <0x03060008 0>;
};
