// SPDX-License-Identifier: GPL-2.0-only
/*
 * LG V60 ThinQ 5G (timelm) lao_ldu, 4.19 CONFIG_MACH_KONA_TIMELM_LAO_LDU.
 * One DTB for revs b, b2, c, d, e: they do not differ in what is ported here
 * (flicker and usb_ds3 acc detect are not ported), so no rev_x in the model.
 * Left out: rev 0.0 and a (other cameras), b1 (no dac,es9219).
 */

/dts-v1/;
#include "kona-timelm.dtsi"

/ {
	model = "LG Electronics, Timelm_lao";
	compatible = "qcom,kona", "lg,timelm";
	qcom,board-id = <0x00070008 0>, <0x00070208 0>, <0x00080008 0>,
			<0x00090008 0>, <0x000A0008 0>;
};

/* Every 4.19 lao_ldu overlay except rev 1.0 disables the modem */
&mdm0 {
	status = "disabled";
};
