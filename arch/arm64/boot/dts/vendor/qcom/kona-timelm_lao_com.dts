// SPDX-License-Identifier: GPL-2.0-only
/*
 * LG V60 ThinQ 5G (timelm) lao_com, 4.19 CONFIG_MACH_KONA_TIMELM_LAO_COM.
 * One DTB for revs 1.0, 1.01, 1.02, b, b2, c, d, e: they do not differ in what is ported here
 * (flicker and usb_ds3 acc detect are not ported), so no rev_x in the model.
 * Left out: rev 0.0 and a (other cameras), b1 (no dac,es9219).
 */

/dts-v1/;
#include "kona-timelm.dtsi"

/ {
	model = "LG Electronics, Timelm_lao";
	compatible = "qcom,kona", "lg,timelm";
	qcom,board-id = <0x000C0008 0>, <0x000C0108 0>, <0x000C0208 0>,
			<0x00070008 0>, <0x00070208 0>, <0x00080008 0>,
			<0x00090008 0>, <0x000A0008 0>;
};

/*
 * NXP PN547 NFC (kona-timelm_lao_com-nfc.dtsi).  No driver in this tree yet.
 */
&qupv3_se1_i2c {
	status = "ok";
	qcom,clk-freq-out = <1000000>;

	pn547@28 {
		compatible = "nxp,pn547";
		reg = <0x28>;
		status = "ok";
		nxp,gpio_sda = <&tlmm 4 0x00>;
		nxp,gpio_scl = <&tlmm 5 0x00>;
		nxp,gpio_ven = <&tlmm 6 0x00>;
		nxp,gpio_mode = <&tlmm 110 0x00>;
		nxp,gpio_irq = <&tlmm 111 0x00>;
		nxp,i2c-pull-up = <1>;
		qcom,clk-src = "BBCLK2";
		interrupt-parent = <&tlmm>;
		interrupts = <111 0>;
		interrupt-names = "nfc_irq";
	};
};
