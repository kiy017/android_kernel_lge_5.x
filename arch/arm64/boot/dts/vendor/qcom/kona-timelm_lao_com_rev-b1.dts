// SPDX-License-Identifier: GPL-2.0-only
/*
 * LG V60 ThinQ 5G (timelm) lao_com rev_b1, from LG
 * kona-timelm_lao_com/kona-timelm_lao_com_rev-b1-overlay.dts.
 * Not ported:
 * - &lge_usb_ds3 accessory detect by comparator (lge,acc_det_vcomp,
 *   lge,acc-detect = <&pm8150l_gpios 10 0x0>, lge,ds-en-gpio =
 *   <&tlmm 169 0>, lge,acc-supply = <&pm8150a_l3>): no lge_usb_ds3 node
 *   or driver here.
 */

#ifndef TIMELM_DTBO
/dts-v1/;
#include "kona-timelm.dtsi"
#endif
#include "kona-timelm_lao_com.dtsi"
#include "kona-timelm-camera_revb.dtsi"
#include "kona-timelm_common-sound_rev-b1.dtsi"

/ {
	model = "LG Electronics, Timelm_lao, rev_b1";
	qcom,board-id = <0x00070108 0>;
};

&pm8150a_l3 {
	regulator-min-microvolt = <1200000>;
	regulator-max-microvolt = <1200000>;
	qcom,init-voltage = <1200000>;
};
