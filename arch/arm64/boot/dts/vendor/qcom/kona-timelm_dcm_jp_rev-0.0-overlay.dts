// SPDX-License-Identifier: GPL-2.0-only
/*
 * dtbo entry for dcm_jp rev_0.0: LG kona-timelm_dcm_jp/kona-timelm_dcm_jp_rev-0.0-overlay.dts.
 * Same source as kona-timelm_dcm_jp_rev-0.0.dts without the base; LK applies it to
 * kona-timelm.dtb (boot image) when its qcom,board-id matches.
 */

/dts-v1/;
/plugin/;

#define TIMELM_DTBO
#include "kona-timelm-dtbo.dtsi"
#include "kona-timelm_dcm_jp_rev-0.0.dts"
