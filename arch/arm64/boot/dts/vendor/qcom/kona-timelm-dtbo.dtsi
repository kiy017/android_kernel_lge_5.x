// SPDX-License-Identifier: GPL-2.0-only
/*
 * Binding headers for the kona-timelm_*_rev-*-overlay.dts dtbo entries.
 * The full DTBs get them through kona-timelm.dtsi, which overlays do not include.
 */

#include <dt-bindings/clock/qcom,camcc-sm8250.h>
#include <dt-bindings/clock/qcom,rpmh.h>
#include <dt-bindings/gpio/gpio.h>
#include <dt-bindings/interrupt-controller/arm-gic.h>
#include <dt-bindings/msm/msm-camera.h>
