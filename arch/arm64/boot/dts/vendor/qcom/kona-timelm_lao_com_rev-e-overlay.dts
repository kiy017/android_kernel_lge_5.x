// SPDX-License-Identifier: GPL-2.0-only
/*
 * dtbo entry for lao_com rev_e: LG kona-timelm_lao_com/kona-timelm_lao_com_rev-e-overlay.dts.
 * Same source as kona-timelm_lao_com_rev-e.dts without the base; LK applies it to
 * kona-timelm.dtb (boot image) when its qcom,board-id matches.
 */

/dts-v1/;
/plugin/;

#define TIMELM_DTBO
#include "kona-timelm-dtbo.dtsi"
#include "kona-timelm_lao_com_rev-e.dts"
