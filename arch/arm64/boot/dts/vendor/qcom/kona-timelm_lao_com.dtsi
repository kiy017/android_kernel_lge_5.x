// SPDX-License-Identifier: GPL-2.0-only
/*
 * LG V60 ThinQ 5G (timelm) lao_com, 4.19 CONFIG_MACH_KONA_TIMELM_LAO_COM.
 * Shared by the kona-timelm_lao_com_rev-*.dts leaves, as LG
 * kona-timelm_lao_com/kona-timelm_lao_com.dtsi is shared by its rev overlays.
 */


/ {
	compatible = "qcom,kona", "lg,timelm";
};

/*
 * NXP PN547 NFC (kona-timelm_lao_com-nfc.dtsi).  No driver in this tree yet.
 */
&qupv3_se1_i2c {
	status = "ok";
	qcom,clk-freq-out = <1000000>;

	pn547@28 {
		compatible = "nxp,pn547";
		reg = <0x28>;
		status = "ok";
		nxp,gpio_sda = <&tlmm 4 0x00>;
		nxp,gpio_scl = <&tlmm 5 0x00>;
		nxp,gpio_ven = <&tlmm 6 0x00>;
		nxp,gpio_mode = <&tlmm 110 0x00>;
		nxp,gpio_irq = <&tlmm 111 0x00>;
		nxp,i2c-pull-up = <1>;
		qcom,clk-src = "BBCLK2";
		interrupt-parent = <&tlmm>;
		interrupts = <111 0>;
		interrupt-names = "nfc_irq";
	};
};
