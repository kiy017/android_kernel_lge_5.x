// SPDX-License-Identifier: GPL-2.0-only
/*
 * timelm: Sony CXD2252 NFC (LM-V600, androidboot.vendor.lge.nfc.vendor=sony)
 * on qupv3_se1_i2c (i2c@984000, gpio4/5 qup1), values from the stock live DT
 * (v60-live.dts cxd22xx-i2c@28).  Driver: nfc-lge/cxd22xx.ko, /dev/cxd22xx-i2c
 * for android.hardware.nfc@1.2-service-cxd22xx.
 * No pinctrl on stock either: the driver requests the GPIOs itself
 * (xrst 110 out low, mode/wake 6 out low, hvdd 14 out high unless charger,
 * tst1 30 out low, irq 111 in, falling edge).  sony,gpio_sda/scl,
 * sony,i2c-pull-up and qcom,clk-src are not read by the driver.
 */

/*
 * timelm: tst1 = gpio30 is in kona-pinctrl.dtsi qcom,gpios-reserved
 * <28 29 30 31 40 41 42 43>.  Unreserving it (img105) reset the phone at
 * ~2.4 s with no panic, so the reservation stays and the driver treats tst1
 * as optional (only CXDNFC_SERVICEMODE_CTL uses it).
 */

&qupv3_se1_i2c {
	status = "ok";
	qcom,clk-freq-out = <400000>;

	cxd22xx-i2c@28 {
		compatible = "sony,cxd22xx-i2c";
		reg = <0x28>;
		status = "ok";
		sony,gpio_sda = <&tlmm 4 0x00>;
		sony,gpio_scl = <&tlmm 5 0x00>;
		sony,gpio_irq = <&tlmm 111 0x00>;
		sony,gpio_hvdd = <&tlmm 14 0x00>;
		sony,gpio_xrst = <&tlmm 110 0x00>;
		sony,gpio_mode = <&tlmm 6 0x00>;
		sony,gpio_tst1 = <&tlmm 30 0x00>;
		sony,i2c-pull-up = <1>;
		qcom,clk-src = "BBCLK2";
		interrupt-parent = <&tlmm>;
		interrupts = <111 0>;
		interrupt-names = "nfc_irq";
	};
};
