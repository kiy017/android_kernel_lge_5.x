// SPDX-License-Identifier: GPL-2.0-only
/*
 * LG V60 ThinQ 5G (timelm) lao_ldu rev_1.0, from LG
 * kona-timelm_lao_ldu/kona-timelm_lao_ldu_rev-1.0-overlay.dts.
 * Not ported:
 * - &lge_usb_ds3 accessory detect by ADC (lge,acc_det_vadc,
 *   lge,ds-en-gpio = <&tlmm 169 0>, lge,acc-supply = <&pm8150a_l3>) and
 *   its &pm8150l_vadc gpio4_pu3 channel (ADC_GPIO4_PU3 = 0x75): no
 *   lge_usb_ds3 node or driver here, and the 5.15 qcom-spmi-adc5 table has
 *   no channel 0x75, so the node would fail the whole pm8150l_vadc probe.
 */

#ifndef TIMELM_DTBO
/dts-v1/;
#include "kona-timelm.dtsi"
#endif
#include "kona-timelm_lao_ldu.dtsi"
#include "kona-timelm-camera_revb.dtsi"
#include "kona-timelm_common-sound_rev-b.dtsi"
#include "kona-timelm_common-flicker.dtsi"

/ {
	model = "LG Electronics, Timelm_lao, rev_1.0";
	qcom,board-id = <0x000C0008 0>;
};

&pm8150a_l3 {
	regulator-min-microvolt = <1200000>;
	regulator-max-microvolt = <1200000>;
	qcom,init-voltage = <1200000>;
};
