// SPDX-License-Identifier: GPL-2.0-only
/*
 * dtbo entry for sb_jp rev_1.0: LG kona-timelm_sb_jp/kona-timelm_sb_jp_rev-1.0-overlay.dts.
 * Same source as kona-timelm_sb_jp_rev-1.0.dts without the base; LK applies it to
 * kona-timelm.dtb (boot image) when its qcom,board-id matches.
 */

/dts-v1/;
/plugin/;

#define TIMELM_DTBO
#include "kona-timelm-dtbo.dtsi"
#include "kona-timelm_sb_jp_rev-1.0.dts"
