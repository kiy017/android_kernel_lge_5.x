// SPDX-License-Identifier: GPL-2.0-only
/*
 * LG V60 ThinQ 5G (timelm) lao_com rev_a, from LG
 * kona-timelm_lao_com/kona-timelm_lao_com_rev-a-overlay.dts.
 * Not ported:
 * - &lge_usb_debugger lge,always-console-enable: no lge_usb_debugger
 *   node or driver here, and this port uses no UART console.
 */

#ifndef TIMELM_DTBO
/dts-v1/;
#include "kona-timelm.dtsi"
#endif
#include "kona-timelm_lao_com.dtsi"
#include "kona-timelm-camera_reva.dtsi"

/ {
	model = "LG Electronics, Timelm_lao, rev_a";
	qcom,board-id = <0x00060008 0>;
};
